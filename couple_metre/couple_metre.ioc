# file: couple_metre.ioc
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ADC1.Channel-0\#ChannelRegularConversion=ADC_CHANNEL_0
ADC1.ContinuousConvMode=ENABLE
ADC1.NbrOfConversion=1
ADC1.NbrOfConversionFlag=1
ADC1.Rank-0\#ChannelRegularConversion=1
ADC1.SamplingTime-0\#ChannelRegularConversion=ADC_SAMPLETIME_3CYCLES
ADC1.master=1
FREERTOS.BinarySemaphores01=myBinarySem01,Dynamic,NULL
FREERTOS.Tasks01=defaultTask,0,128,StartDefaultTask,Default,NULL,Dynamic,NULL,NULL;ReadSensor,0,128,StartTask02,Default,NULL,Dynamic,NULL,NULL;vTaskmain,0,128,StartTask03,Default,NULL,Dynamic,NULL,NULL
Mcu.Family=STM32F7
Mcu.Name=STM32F746NGHx
Mcu.Package=TFBGA216
NVIC.PriorityGroup=NVIC_PRIORITYGROUP_4
PA0/WKUP.Signal=ADCx_IN0
ProjectManager.HeapSize=0x200
ProjectManager.StackSize=0x400
ProjectManager.TargetToolchain=STM32CubeIDE
RCC.HSE_VALUE=25000000
RCC.HSI_VALUE=16000000
RCC.LSE_VALUE=32768
RCC.USBFreq_Value=96000000
RCC.VCOOutputFreq_Value=192000000
SH.ADCx_IN0.0=ADC1_IN0,IN0
VP_FREERTOS_VS_CMSIS_V1.Mode=CMSIS_V1
board=custom

// file: Core/Src/main.c
/* USER CODE BEGIN Header */
/**
  ******************************************************************************
  * @file           : main.c
  * @brief          : Main program body
  ******************************************************************************
  * @attention
  *
  * Copyright (c) 2024 STMicroelectronics.
  * All rights reserved.
  *
  * This software is licensed under terms that can be found in the LICENSE file
  * in the root directory of this software component.
  * If no LICENSE file comes with this software, it is provided AS-IS.
  *
  ******************************************************************************
  */
/* USER CODE END Header */
#include "main.h"
#include "cmsis_os.h"

ADC_HandleTypeDef hadc1;
QueueHandle_t xTorqueSensorQueue;

osThreadId defaultTaskHandle;
osThreadId ReadSensorHandle;
osThreadId mainHandle;
osSemaphoreId semph;

void SystemClock_Config(void);
static void MX_GPIO_Init(void);
static void MX_ADC1_Init(void);
void vTaskmain(void * pvParmeter);
void vTaskReadSensor(void const * argument);

int main(void)
{

  /* MCU Configuration--------------------------------------------------------*/

  /* Reset of all peripherals, Initializes the Flash interface and the Systick. */
  HAL_Init();

  /* Configure the system clock */
  SystemClock_Config();

  /* Initialize all configured peripherals */
  MX_GPIO_Init();
  MX_ADC1_Init();

  /* Create the semaphores(s) */
  /* definition and creation of myBinarySem01 */
  osSemaphoreDef(semph);
  semph = osSemaphoreCreate(osSemaphore(semph), 1);

  /* USER CODE BEGIN RTOS_QUEUES */
  /* add queues, ... */
  xTorqueSensorQueue = xQueueCreate(1, sizeof(float));
  /* USER CODE END RTOS_QUEUES */

  /* Create the thread(s) */

  /* definition and creation of ReadSensor */
  osThreadDef(ReadSensor, vTaskReadSensor, osPriorityNormal, 0, 128);
  ReadSensorHandle = osThreadCreate(osThread(ReadSensor), NULL);

  /* definition and creation of vTaskmain */
  osThreadDef(main, vTaskmain, osPriorityNormal, 0, 128);
  mainHandle = osThreadCreate(osThread(main), NULL);

  /* Start scheduler */
  osKernelStart();

  /* We should never get here as control is now taken by the scheduler */
  /* Infinite loop */
  while (1)
  {

  }
}

void SystemClock_Config(void)
{
  RCC_OscInitTypeDef RCC_OscInitStruct = {0};
  RCC_ClkInitTypeDef RCC_ClkInitStruct = {0};

  /** Configure the main internal regulator output voltage
  */
  __HAL_RCC_PWR_CLK_ENABLE();
  __HAL_PWR_VOLTAGESCALING_CONFIG(PWR_REGULATOR_VOLTAGE_SCALE3);

  /** Initializes the RCC Oscillators according to the specified parameters
  * in the RCC_OscInitTypeDef structure.
  */
  RCC_OscInitStruct.OscillatorType = RCC_OSCILLATORTYPE_HSI;
  RCC_OscInitStruct.HSIState = RCC_HSI_ON;
  RCC_OscInitStruct.HSICalibrationValue = RCC_HSICALIBRATION_DEFAULT;
  RCC_OscInitStruct.PLL.PLLState = RCC_PLL_NONE;
  if (HAL_RCC_OscConfig(&RCC_OscInitStruct) != HAL_OK)
  {
    Error_Handler();
  }

  /** Initializes the CPU, AHB and APB buses clocks
  */
  RCC_ClkInitStruct.ClockType = RCC_CLOCKTYPE_HCLK|RCC_CLOCKTYPE_SYSCLK
                              |RCC_CLOCKTYPE_PCLK1|RCC_CLOCKTYPE_PCLK2;
  RCC_ClkInitStruct.SYSCLKSource = RCC_SYSCLKSOURCE_HSI;
  RCC_ClkInitStruct.AHBCLKDivider = RCC_SYSCLK_DIV1;
  RCC_ClkInitStruct.APB1CLKDivider = RCC_HCLK_DIV1;
  RCC_ClkInitStruct.APB2CLKDivider = RCC_HCLK_DIV1;

  if (HAL_RCC_ClockConfig(&RCC_ClkInitStruct, FLASH_LATENCY_0) != HAL_OK)
  {
    Error_Handler();
  }
}

static void MX_ADC1_Init(void)
{

  ADC_ChannelConfTypeDef sConfig = {0};

  /** Configure the global features of the ADC (Clock, Resolution, Data Alignment and number of conversion)
  */
  hadc1.Instance = ADC1;
  hadc1.Init.ClockPrescaler = ADC_CLOCK_SYNC_PCLK_DIV2;
  hadc1.Init.Resolution = ADC_RESOLUTION_12B;
  hadc1.Init.ScanConvMode = ADC_SCAN_DISABLE;
  hadc1.Init.ContinuousConvMode = DISABLE;
  hadc1.Init.DiscontinuousConvMode = DISABLE;
  hadc1.Init.ExternalTrigConvEdge = ADC_EXTERNALTRIGCONVEDGE_NONE;
  hadc1.Init.ExternalTrigConv = ADC_SOFTWARE_START;
  hadc1.Init.DataAlign = ADC_DATAALIGN_RIGHT;
  hadc1.Init.NbrOfConversion = 1;
  hadc1.Init.DMAContinuousRequests = DISABLE;
  hadc1.Init.EOCSelection = ADC_EOC_SINGLE_CONV;
  if (HAL_ADC_Init(&hadc1) != HAL_OK)
  {
    Error_Handler();
  }

  /** Configure for the selected ADC regular channel its corresponding rank in the sequencer and its sample time.
  */
  sConfig.Channel = ADC_CHANNEL_0;
  sConfig.Rank = ADC_REGULAR_RANK_1;
  sConfig.SamplingTime = ADC_SAMPLETIME_3CYCLES;
  if (HAL_ADC_ConfigChannel(&hadc1, &sConfig) != HAL_OK)
  {
    Error_Handler();
  }

}

static void MX_GPIO_Init(void)
{

  /* GPIO Ports Clock Enable */
  __HAL_RCC_GPIOA_CLK_ENABLE();

}

/* USER CODE BEGIN Header_StartDefaultTask */

void vTaskReadTorqueSensor(void *pvParameters) {
  uint16_t adcValue;
  float inputVoltage, torqueValue;

  for(;;)
  {
    // Start ADC conversion
    if (HAL_ADC_Start(&hadc1) != HAL_OK) {
      // Handle ADC start error
      // (e.g., print error message, retry, etc.)
      continue;
    }

    // Wait for conversion to complete
    if (HAL_ADC_PollForConversion(&hadc1, portMAX_DELAY) != HAL_OK) {
      // Handle ADC conversion timeout error
      // (e.g., print error message, retry, etc.)
      continue;
    }

    // Read the converted value
    adcValue = HAL_ADC_GetValue(&hadc1);

    // Convert ADC value to voltage (assuming a linear relationship)
    inputVoltage = (float)adcValue * (2.5f / ((float)(1 << ADC_RESOLUTION_12B)));

    // **Optional: Apply high-pass filter (replace with your filter implementation)**
    // This is a basic example, adjust based on your filter design
    static float previousVoltage = 0.0f;
    torqueValue = inputVoltage - previousVoltage;
    previousVoltage = inputVoltage;

    // Convert voltage to torque (replace with your calibration or conversion function)
    // This example assumes a direct mapping, you might need calibration factors
    torqueValue = inputVoltage; // Replace with your conversion logic

    // Signal completion of reading
    xSemaphoreGive(semph);
    // Send torque value to the queue
    if (xQueueSend(xTorqueSensorQueue, &torqueValue, portMAX_DELAY) != pdPASS) {
      // Handle queue send error
    }
    // Task suspended until activated
    vTaskSuspend(NULL);
  }
}

void vTaskmain(void *pvParameters) {

  for(;;) {
    // Attente de la notification du sémaphore
    xSemaphoreTake(semph, portMAX_DELAY);
    xTorqueSensorQueue = xQueueCreate(1, sizeof(float));
    if (xTorqueSensorQueue == NULL) {
      // Handle queue creation error
    }
    // Traitement de la valeur lue du capteur
    float torqueValue = *(float *)pvParameters; // Accès à la valeur du capteur via le pointeur pvParameters

    if (xQueueReceive(xTorqueSensorQueue, &torqueValue, portMAX_DELAY) != pdTRUE) {
      // Handle queue receive error
    }
    // Exemple d'utilisation de la valeur de couple
    // ...

    // Envoi de la valeur de couple à d'autres tâches (optionnel)
    // ...

    // Tâche bloquée jusqu'à la prochaine lecture du capteur
    vTaskSuspend(NULL);
  }
}

void Error_Handler(void)
{
  __disable_irq();
  while (1)
  {
  }
}
