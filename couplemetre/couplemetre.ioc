# file: couplemetre.ioc
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ADC1.Channel-1\#ChannelRegularConversion=ADC_CHANNEL_0
ADC1.Channel-2\#ChannelInjectedConversion=ADC_CHANNEL_0
ADC1.ContinuousConvMode=ENABLE
ADC1.InjNumberOfConversion=1
ADC1.InjectedOffset-2\#ChannelInjectedConversion=0
ADC1.InjectedRank-2\#ChannelInjectedConversion=1
ADC1.NbrOfConversionFlag=1
ADC1.Rank-1\#ChannelRegularConversion=1
ADC1.SamplingTime-1\#ChannelRegularConversion=ADC_SAMPLETIME_3CYCLES
ADC1.SamplingTime-2\#ChannelInjectedConversion=ADC_SAMPLETIME_3CYCLES
ADC1.master=1
Mcu.Family=STM32F4
Mcu.Name=STM32F411V(C-E)Tx
Mcu.Package=LQFP100
NVIC.PriorityGroup=NVIC_PRIORITYGROUP_0
PA0-WKUP.Signal=ADCx_IN0
ProjectManager.HeapSize=0x200
ProjectManager.StackSize=0x400
ProjectManager.TargetToolchain=STM32CubeIDE
RCC.48MHZClocksFreq_Value=48000000
RCC.AHBFreq_Value=96000000
RCC.APB1CLKDivider=RCC_HCLK_DIV4
RCC.APB1Freq_Value=24000000
RCC.APB1TimFreq_Value=48000000
RCC.APB2Freq_Value=96000000
RCC.APB2TimFreq_Value=96000000
RCC.CortexFreq_Value=96000000
RCC.HCLKFreq_Value=96000000
RCC.HSE_VALUE=8000000
RCC.HSI_VALUE=16000000
RCC.LSE_VALUE=32768
RCC.PLLI2SM=5
RCC.PLLI2SN=200
RCC.PLLM=4
RCC.PLLP=RCC_PLLP_DIV4
RCC.PLLQ=8
RCC.PLLSourceVirtual=RCC_PLLSOURCE_HSE
RCC.SYSCLKFreq_VALUE=96000000
RCC.SYSCLKSource=RCC_SYSCLKSOURCE_PLLCLK
RCC.VCOOutputFreq_Value=384000000
SH.ADCx_IN0.0=ADC1_IN0,IN0
board=STM32F411E-DISCO

// file: Core/Src/main.c
/* USER CODE BEGIN Header */
/**
  ******************************************************************************
  * @file           : main.c
  * @brief          : Main program body
  ******************************************************************************
  * @attention
  *
  * Copyright (c) 2024 STMicroelectronics.
  * All rights reserved.
  *
  * This software is licensed under terms that can be found in the LICENSE file
  * in the root directory of this software component.
  * If no LICENSE file comes with this software, it is provided AS-IS.
  *
  ******************************************************************************
  */
/* USER CODE END Header */
#include "main.h"
#include "adc.h"
#include "gpio.h"

#define FILTER_ALPHA 0.1f // Adjust this value based on filter requirements
//#define INPUT_FILTER_R1 100 // Ohms
//#define INPUT_FILTER_C 100e-9 // Farads
//#define INPUT_FILTER_R2 100 // Ohms
//#define VOLTAGE_TO_TORQUE_FACTOR 0.17
//#define TORQUE_RESOLUTION 0.0244
#define VREF_VOLTAGE 3.3f    // Voltage reference of the ADC
#define ADC_RESOLUTION 4095  // ADC resolution (12-bit)
#define VOLTAGE_TO_TORQUE_FACTOR 0.17f  // Conversion factor from voltage to torque
#define MIN_TORQUE_VALUE 0.05f  // Minimum torque value
#define MAX_TORQUE_VALUE 100.0f  // Maximum torque value
#define INPUT_FILTER_COEFFICIENT 0.05f
#define MAX_TORQUE_VOLTAGE 5.0f
#define MIN_TORQUE_VOLTAGE -5.0f
#define FILTER_TIME_CONSTANT 0.1f // Adjust the time constant based on your requirements
#define SAMPLING_FREQUENCY 50.0f // Assuming a sampling frequency of 100 Hz
// Global variable
//float previousFilteredValue = 0.0f;
//float previousFilteredTorque = 0.0f;
float torqueSignal = 0.0f;
float filteredValue = 0.0f;
float torque_value = 0.0f;
uint32_t adcValue;
float filteredTorque;
float torque;
float torqueVoltage;
float filteredTorqueValue;
float previousFilteredTorque = 0.0f;
float torqueValue;
float filteredTorqueVoltage;

void SystemClock_Config(void);
float applyInputFilter(float rawTorqueVoltage);
//float applyLowPassFilter(float rawValue, float previousFilteredValue);
float mapRange(float value, float inMin, float inMax, float outMin, float outMax);
float adcToTorque(int adcValue);
float mapTorqueVoltage(uint16_t adcValue);
float applyLowPassFilter(float currentValue, float previousValue) ;

int main(void)
{

  /* MCU Configuration--------------------------------------------------------*/

  /* Reset of all peripherals, Initializes the Flash interface and the Systick. */
  HAL_Init();

  /* Configure the system clock */
  SystemClock_Config();

  /* Initialize all configured peripherals */
  MX_GPIO_Init();
  MX_ADC1_Init();

  /* Infinite loop */
  /* USER CODE BEGIN WHILE */
  while (1)
  {
      if (HAL_ADC_Start(&hadc1) != HAL_OK)
      {
          // Handle ADC start error
      }

      // Wait for ADC conversion to complete
      if (HAL_ADC_PollForConversion(&hadc1, HAL_MAX_DELAY) != HAL_OK)
      {
          // Handle ADC conversion error
      }

      // Read the converted ADC value
      adcValue = HAL_ADC_GetValue(&hadc1);
      float previousTorqueValue=0.0f;
      // Convert ADC value to torque using adcToTorque function
      torque = adcToTorque(adcValue);
      // Apply low-pass filter to torque value if needed
      filteredTorqueValue = applyLowPassFilter(torque, previousTorqueValue);
      previousTorqueValue = filteredTorqueValue; // Update previous value for next iteration

      // Apply input filtering
      //filteredValue = applyInputFilter((float)adcValue);

      // Convert filtered value to torque signal
      torqueSignal = filteredValue * (VREF_VOLTAGE / ADC_RESOLUTION);

      // Perform linear transformation to torque voltage
      float previousTorqueVoltage = 0.0f;
      torqueVoltage = mapTorqueVoltage(adcValue);
      filteredTorqueVoltage = applyLowPassFilter(torqueVoltage, previousTorqueVoltage);
      previousTorqueVoltage = filteredTorqueVoltage; // Update previous value for next iteration

      //torqueVoltage = torqueSignal * 1.0f;
      // Apply low-pass filter to torqueVoltage

      // Convert filtered torque voltage to torque value
      torqueValue = filteredTorqueVoltage * VOLTAGE_TO_TORQUE_FACTOR;

      // Apply low-pass filter to torque value if needed
      //float filteredTorqueValue = applyLowPassFilter(torqueValue, previousTorqueValue);
      //previousTorqueValue = filteredTorqueValue; // Update previous value for next iteration

      // Apply low-pass filter to smooth the torque value
      //filteredTorque = applyLowPassFilter(torqueVoltage, previousFilteredTorque);

      // Map the filtered torque to the desired range [0.05, 100]

      torque_value = mapRange(filteredTorque, MIN_TORQUE_VALUE, MAX_TORQUE_VALUE, 0.05f, 100.0f);

      // Store previous filtered torque for next iteration

      previousFilteredTorque = filteredTorque;

      // Use the torque_value as needed

      // Delay before next reading
      HAL_Delay(100);  // Adjust delay as needed
  }

  return 0;
}
/*
	  // Start ADC conversion
	  if (HAL_ADC_Start(&hadc1) != HAL_OK)
	  {
	  // ADC start error handling
	    	}

	  // Wait for conversion to complete
	  if (HAL_ADC_PollForConversion(&hadc1, HAL_MAX_DELAY) != HAL_OK)
	    {
	  // ADC conversion error handling
	         }

	  // Read the converted value
	  adcValue = HAL_ADC_GetValue(&hadc1);

	  // Apply input filtering
	  float filteredValue = applyInputFilter((float)adcValue);

	  // Convert ADC value to voltage
	  torque_signal = filteredValue * (3.3f / 4095.0f); // Assuming Vref+ = 10V and 12-bit ADC

	  // Perform the linear transformation
	  float torqueVoltage = torque_signal * VOLTAGE_TO_TORQUE_FACTOR;
	  // Apply low-pass filter
	  filtered_torque = torqueVoltage * TORQUE_RESOLUTION  ;
	  torque_value = applyLowPassFilter(filtered_torque, previousFilteredTorque);

	  // Store previous filtered values for next iteration
	  previousFilteredValue = filteredValue;
	  previousFilteredTorque = torque_value;
*/
	 /* for (i=0;i<50;i++)
	  {
		  i=i+1;
	  }*/
/*
		// Start ADC conversion
		if (HAL_ADC_Start(&hadc1) != HAL_OK) {
			Error_Handler();
		}

		// Wait for conversion to complete
		if (HAL_ADC_PollForConversion(&hadc1, HAL_MAX_DELAY) != HAL_OK) {
			Error_Handler();
		}

		// Read ADC value
		 adcValue = HAL_ADC_GetValue(&hadc1);

		// Convert ADC value to voltage (assuming 3.3V reference voltage)
		 voltage = adcValue * (3.3f / 4096.0f);

		// Apply conversion factor to map voltage to torque sensor range
		 torqueVoltage = voltage * VOLTAGE_TO_TORQUE_FACTOR;

		filteredTorqueValue = applyLowPassFilter(torqueVoltage, filteredTorqueValue);
		// Calculate torque value based on the torque resolution
		 torque_Value = torqueVoltage * TORQUE_RESOLUTION  ;
*/

    /* USER CODE END WHILE */

//low Pass filtre
/*float applyLowPassFilter(float rawValue, float previousFilteredValue) {
    return (FILTER_ALPHA * rawValue) + ((1.0f - FILTER_ALPHA) * previousFilteredValue);
}
*/
//Input Filtre
float applyInputFilter(float rawTorqueVoltage) {
    // Apply input filtering based on your specific requirements
    // You may need to adjust these coefficients based on your circuit design
    float filteredTorqueVoltage = rawTorqueVoltage * INPUT_FILTER_COEFFICIENT;
    return filteredTorqueVoltage;
}

//fuction for calculate torque value
float mapRange(float value, float inMin, float inMax, float outMin, float outMax) {
    // Map the value from the input range [inMin, inMax] to the output range [outMin, outMax]
    return (value - inMin) * (outMax - outMin) / (inMax - inMin) + outMin;
}
//Torque function
float adcToTorque(int adcValue) {
    // Calculate voltage from ADC reading
    float voltage = (adcValue / (float)4095) * 3.3f;

    // Calculate torque using linear scaling
    float torque = ((voltage * (100.0f - 0.05f)) / 3.3f) + 0.05f;

    return torque;
}

// Convert ADC value to torque voltage within the desired range
float mapTorqueVoltage(uint16_t adcValue) {
float torqueVoltage = ((float)adcValue / ADC_RESOLUTION) * (MAX_TORQUE_VOLTAGE - MIN_TORQUE_VOLTAGE) + MIN_TORQUE_VOLTAGE;
    return torqueVoltage;
}

// Function to apply a first-order low-pass filter

float applyLowPassFilter(float currentValue, float previousValue) {
    // Calculate the filter alpha based on the time constant and sampling frequency
    float alpha = FILTER_TIME_CONSTANT * SAMPLING_FREQUENCY / (FILTER_TIME_CONSTANT * SAMPLING_FREQUENCY + 1.0f);

    // Apply the low-pass filter
    float filteredValue = alpha * currentValue + (1.0f - alpha) * previousValue;

    return filteredValue;
}

void SystemClock_Config(void)
{
  RCC_OscInitTypeDef RCC_OscInitStruct = {0};
  RCC_ClkInitTypeDef RCC_ClkInitStruct = {0};

  /** Configure the main internal regulator output voltage
  */
  __HAL_RCC_PWR_CLK_ENABLE();
  __HAL_PWR_VOLTAGESCALING_CONFIG(PWR_REGULATOR_VOLTAGE_SCALE1);

  /** Initializes the RCC Oscillators according to the specified parameters
  * in the RCC_OscInitTypeDef structure.
  */
  RCC_OscInitStruct.OscillatorType = RCC_OSCILLATORTYPE_HSE;
  RCC_OscInitStruct.HSEState = RCC_HSE_ON;
  RCC_OscInitStruct.PLL.PLLState = RCC_PLL_ON;
  RCC_OscInitStruct.PLL.PLLSource = RCC_PLLSOURCE_HSE;
  RCC_OscInitStruct.PLL.PLLM = 4;
  RCC_OscInitStruct.PLL.PLLN = 192;
  RCC_OscInitStruct.PLL.PLLP = RCC_PLLP_DIV4;
  RCC_OscInitStruct.PLL.PLLQ = 8;
  if (HAL_RCC_OscConfig(&RCC_OscInitStruct) != HAL_OK)
  {
    Error_Handler();
  }

  /** Initializes the CPU, AHB and APB buses clocks
  */
  RCC_ClkInitStruct.ClockType = RCC_CLOCKTYPE_HCLK|RCC_CLOCKTYPE_SYSCLK
                              |RCC_CLOCKTYPE_PCLK1|RCC_CLOCKTYPE_PCLK2;
  RCC_ClkInitStruct.SYSCLKSource = RCC_SYSCLKSOURCE_PLLCLK;
  RCC_ClkInitStruct.AHBCLKDivider = RCC_SYSCLK_DIV1;
  RCC_ClkInitStruct.APB1CLKDivider = RCC_HCLK_DIV4;
  RCC_ClkInitStruct.APB2CLKDivider = RCC_HCLK_DIV1;

  if (HAL_RCC_ClockConfig(&RCC_ClkInitStruct, FLASH_LATENCY_3) != HAL_OK)
  {
    Error_Handler();
  }
}

void Error_Handler(void)
{
  __disable_irq();
  while (1)
  {
  }
}
